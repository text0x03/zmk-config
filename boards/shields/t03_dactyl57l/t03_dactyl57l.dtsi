#include <dt-bindings/zmk/matrix_transform.h>
#include "t03_dactyl57l-layouts.dtsi"

/ {
    chosen {
        zmk,physical-layout = &default_layout;
    };

    kscan: kscan {
        compatible = "zmk,kscan-gpio-matrix";
        diode-direction = "col2row";
        wakeup-source;

        row-gpios =
            <&pro_micro 3 (GPIO_ACTIVE_HIGH | GPIO_PULL_DOWN)>;
    };

    default_transform: default_transform {
        compatible = "zmk,matrix-transform";
        columns = <2>;
        rows = <1>;

        map = <
            RC(0,0) RC(0,1)
        >;
    };
};