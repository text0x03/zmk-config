## boards/shields/t03_dactyl57l/Kconfig.defconfig
```kconfig
if SHIELD_T03_DACTYL57L_LEFT

config ZMK_KEYBOARD_NAME
    default "t03_dactyl57l_"

config ZMK_SPLIT_ROLE_CENTRAL
    default y

endif # SHIELD_T03_DACTYL57L_LEFT

if SHIELD_T03_DACTYL57L_LEFT || SHIELD_T03_DACTYL57L_RIGHT

config ZMK_SPLIT
    default y

endif # SHIELD_T03_DACTYL57L_LEFT || SHIELD_T03_DACTYL57L_RIGHT
```

## boards/shields/t03_dactyl57l/Kconfig.shield
```kconfig
config SHIELD_T03_DACTYL57L_LEFT
    def_bool $(shields_list_contains,t03_dactyl57l_left)

config SHIELD_T03_DACTYL57L_RIGHT
    def_bool $(shields_list_contains,t03_dactyl57l_right)
```
